## buildroot-external/Config.in
```kconfig
source "$BR2_EXTERNAL_BOOT1OOT_PATH/package/boot1oot/Config.in"
source "$BR2_EXTERNAL_BOOT1OOT_PATH/package/dislocker/Config.in"
```

## buildroot-external/configs/boot1oot_x86_64_defconfig
```kconfig
BR2_x86_64=y
BR2_OPTIMIZE_S=y
BR2_TOOLCHAIN_BUILDROOT_MUSL=y
BR2_INIT_BUSYBOX=y
BR2_SYSTEM_BIN_SH_BUSYBOX=y
BR2_ROOTFS_DEVICE_CREATION_DYNAMIC_DEVTMPFS=y
BR2_TARGET_GENERIC_HOSTNAME="boot1oot"
BR2_TARGET_GENERIC_ISSUE="Boot1oot minimal live audit ISO"
BR2_ROOTFS_OVERLAY="$(BR2_EXTERNAL_BOOT1OOT_PATH)/board/boot1oot/rootfs_overlay"
BR2_ROOTFS_POST_BUILD_SCRIPT="$(BR2_EXTERNAL_BOOT1OOT_PATH)/board/boot1oot/post-build.sh"

BR2_LINUX_KERNEL=y
BR2_LINUX_KERNEL_LATEST_VERSION=y
BR2_LINUX_KERNEL_USE_CUSTOM_CONFIG=y
BR2_LINUX_KERNEL_CUSTOM_CONFIG_FILE="$(BR2_EXTERNAL_BOOT1OOT_PATH)/board/boot1oot/linux.config"
BR2_LINUX_KERNEL_BZIMAGE=y

BR2_PACKAGE_BUSYBOX=y
BR2_PACKAGE_BUSYBOX_SHOW_OTHERS=y
BR2_PACKAGE_BASH=y
BR2_PACKAGE_BOOT1OOT=y
BR2_PACKAGE_CHNTPW=y
BR2_PACKAGE_DISLOCKER=y
BR2_PACKAGE_NTFS_3G=y
BR2_PACKAGE_OPENSSL=y
BR2_PACKAGE_LIBOPENSSL=y
BR2_PACKAGE_LIBOPENSSL_BIN=y

BR2_TARGET_ROOTFS_CPIO=y
BR2_TARGET_ROOTFS_CPIO_GZIP=y
# BR2_TARGET_ROOTFS_TAR is not set
```

## buildroot-external/package/boot1oot/Config.in
```kconfig
config BR2_PACKAGE_BOOT1OOT
	bool "boot1oot"
	help
	  Minimal launcher for the Boot1oot RAM-only live ISO.
```

## buildroot-external/package/chntpw/Config.in
```kconfig
config BR2_PACKAGE_CHNTPW
	bool "chntpw"
	help
	  Offline Windows registry/SAM editor and helper tools.

	  Boot1oot installs chntpw, reged, sampasswd, and samusrgrp
	  from the upstream source archive.

	  https://pogostick.net/~pnh/ntpasswd/
```

## buildroot-external/package/dislocker/Config.in
```kconfig
config BR2_PACKAGE_DISLOCKER
	bool "dislocker"
	select BR2_PACKAGE_LIBFUSE3
	select BR2_PACKAGE_MBEDTLS
	help
	  FUSE driver to read BitLocker encrypted volumes.

	  https://github.com/Aorimn/dislocker
```
